## buildroot/configs/rockchip_rk3568_100ask_defconfig
```kconfig
#include "audio.config"
#include "audio_gst.config"
#include "base.config"
#include "base_extra.config"
#include "benchmark.config"
#include "bt.config"
#include "camera.config"
#include "camera_gst.config"
#include "debug.config"
#include "debug2.config"
#include "weston.config"
#include "gpu.config"
#include "network.config"
#include "ntfs.config"
#include "video_mpp.config"
#include "video_gst.config"
#include "video_gst_rtsp.config"
#include "powermanager.config"
#include "rk356x_arm64.config"
#include "test.config"
#include "wifi.config"
BR2_PACKAGE_RKWIFIBT_AP6256=y
BR2_PACKAGE_RKWIFIBT_BTUART="ttyS8"
BR2_PACKAGE_RKNPU2=y
# BR2_PACKAGE_RKSCRIPT_IODOMAIN is not set
BR2_PACKAGE_LVGL=y
BR2_PACKAGE_SDL2=y
BR2_PACKAGE_DBUS_GLIB=y
BR2_PACKAGE_BLUEZ5_UTILS_TEST=y
```
